## firmware/main/Kconfig.projbuild
```kconfig
menu "FLORA SENSE AI"

    config FLORA_WIFI_SSID
        string "Wi-Fi SSID"
        default ""

    config FLORA_WIFI_PASSWORD
        string "Wi-Fi password"
        default ""

    config FLORA_DEVICE_ID
        string "Device identity"
        default "FLORA-ESP32-DEV"

    config FLORA_PLANT_ID
        string "Plant binding"
        default "PLANT-DEV"

    config FLORA_MODE
        string "Operating mode TEST/MANUAL/AUTO"
        default "TEST"

    config FLORA_MQTT_URI
        string "MQTT broker URI"
        default "mqtts://localhost:8883"

    config FLORA_MQTT_USERNAME
        string "Device MQTT username"
        default ""

    config FLORA_MQTT_PASSWORD
        string "Device MQTT password"
        default ""

    config FLORA_SOIL_ADC_GPIO
        int "Soil ADC GPIO"
        default 4

    config FLORA_I2C_SDA_GPIO
        int "I2C SDA GPIO"
        default 8

    config FLORA_I2C_SCL_GPIO
        int "I2C SCL GPIO"
        default 9

    config FLORA_PUMP_GPIO
        int "Pump driver GPIO"
        default 5

    config FLORA_SAMPLE_INTERVAL_MS
        int "Sampling interval milliseconds"
        default 30000
        range 5000 3600000

    config FLORA_MAX_PUMP_RUN_MS
        int "Maximum local pump run milliseconds"
        default 120000
        range 1000 1800000

endmenu
```

## firmware/sdkconfig.defaults
```kconfig
CONFIG_IDF_TARGET_ESP32S3=y
CONFIG_COMPILER_OPTIMIZATION_SIZE=y
CONFIG_FREERTOS_HZ=1000
```
